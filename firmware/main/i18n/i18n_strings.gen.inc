    {"settings", {"Settings", "设置", "設定", "設定", "설정", "Réglages", "Einstellungen", "Ajustes", "Настройки", "Optiones"}},
    {"device", {"Device", "设备", "裝置", "デバイス", "장치", "Appareil", "Gerät", "Dispositivo", "Устройство", "Machina"}},
    {"brightness", {"Brightness", "亮度", "亮度", "明るさ", "밝기", "Luminosité", "Helligkeit", "Brillo", "Яркость", "Luminositas"}},
    {"volume", {"Volume", "音量", "音量", "音量", "볼륨", "Volume", "Lautstärke", "Volumen", "Громкость", "Sonus"}},
    {"button", {"Button", "按键", "按鍵", "ボタン", "버튼", "Bouton", "Taste", "Botón", "Кнопка", "Bulla"}},
    {"time_date", {"Time & Date", "时间与日期", "時間與日期", "時刻と日付", "시간 및 날짜", "Heure et date", "Zeit & Datum", "Hora y fecha", "Время и дата", "Tempus et dies"}},
    {"set_time", {"Set Time", "设置时间", "設定時間", "時刻を設定", "시간 설정", "Régler l'heure", "Zeit einstellen", "Ajustar hora", "Установить время", "Pone tempus"}},
    {"set_date", {"Set Date", "设置日期", "設定日期", "日付を設定", "날짜 설정", "Régler la date", "Datum einstellen", "Ajustar fecha", "Установить дату", "Pone diem"}},
    {"language", {"Language", "语言", "語言", "言語", "언어", "Langue", "Sprache", "Idioma", "Язык", "Lingua"}},
    {"system_slots", {"System Slots", "系统槽位", "系統槽位", "システムスロット", "시스템 슬롯", "Emplacements", "Systemslots", "Ranuras", "Слоты системы", "Loculi systematis"}},
    {"switch_slot", {"Switch to other slot", "切换到另一系统", "切換到另一系統", "別スロットへ切替", "다른 슬롯으로 전환", "Basculer", "Anderen Slot starten", "Cambiar de ranura", "Переключить слот", "Muta loculum"}},
    {"clone_slot", {"Clone current to other", "备份当前到另一槽", "備份目前到另一槽", "現在の領域を複製", "현재 슬롯 복제", "Cloner", "Aktuellen klonen", "Clonar actual", "Клонировать", "Copia loculum"}},
    {"firmware", {"Firmware", "固件", "韌體", "ファームウェア", "펌웨어", "Micrologiciel", "Firmware", "Firmware", "Прошивка", "Firmware"}},
    {"version", {"Version", "版本", "版本", "バージョン", "버전", "Version", "Version", "Versión", "Версия", "Versio"}},
    {"slot_running", {"running", "运行中", "執行中", "実行中", "실행 중", "actif", "läuft", "activo", "работает", "currit"}},
    {"slot_ready", {"backup ok", "备份可用", "備份可用", "予備あり", "백업 양호", "secours ok", "Sicherung ok", "respaldo ok", "резерв ок", "copia parata"}},
    {"slot_empty", {"empty", "空", "空", "空き", "비어 있음", "vide", "leer", "vacío", "пусто", "vacua"}},
    {"no_slots", {"No slots found", "未找到槽位", "找不到槽位", "スロットなし", "슬롯 없음", "Aucun emplacement", "Keine Slots", "Sin ranuras", "Слотов нет", "Nulli loculi"}},
    {"switching", {"Switching slot...", "正在切换系统…", "正在切換系統…", "切替中…", "전환 중…", "Basculement…", "Wechsle Slot…", "Cambiando…", "Переключение…", "Mutans…"}},
    {"cloning", {"Cloning firmware...", "正在备份固件…", "正在備份韌體…", "複製中…", "복제 중…", "Clonage…", "Kopiere…", "Clonando…", "Копирование…", "Copians…"}},
    {"cloned", {"Cloned. Switch to use it.", "备份完成，切换即可使用", "備份完成，切換即可使用", "複製完了", "복제 완료", "Cloné", "Kopiert", "Clonado", "Скопировано", "Copiatum"}},
    {"blocked", {"Other slot already has a backup", "另一槽已有备份", "另一槽已有備份", "別スロットに予備あり", "다른 슬롯에 백업 있음", "Autre emplacement occupé", "Anderer Slot belegt", "Otra ranura ocupada", "Другой слот занят", "Alius loculus plenus"}},
    {"failed", {"Failed", "失败", "失敗", "失敗", "실패", "Échec", "Fehlgeschlagen", "Falló", "Ошибка", "Defecit"}},
    {"app_alarm", {"Alarm Clock", "闹钟", "鬧鐘", "アラーム", "알람", "Réveil", "Wecker", "Alarma", "Будильник", "Horologium"}},
    {"app_watchface", {"Watch Face", "表盘", "錶盤", "文字盤", "워치페이스", "Cadran", "Zifferblatt", "Esfera", "Циферблат", "Facies"}},
    {"app_stopwatch", {"Stopwatch", "秒表", "碼錶", "ストップウォッチ", "스톱워치", "Chronomètre", "Stoppuhr", "Cronómetro", "Секундомер", "Chronometrum"}},
    {"app_qiuqiu", {"Qiuqiu", "球球", "球球", "たまちゃん", "공공이", "Qiuqiu", "Qiuqiu", "Qiuqiu", "Qiuqiu", "Qiuqiu"}},
    {"app_settings", {"Settings", "设置", "設定", "設定", "설정", "Réglages", "Einstellungen", "Ajustes", "Настройки", "Optiones"}},
    {"alarm_list", {"Alarms", "闹钟", "鬧鐘", "アラーム", "알람", "Alarmes", "Alarme", "Alarmas", "Будильники", "Horologia"}},
    {"add_alarm", {"Add Alarm", "添加闹钟", "新增鬧鐘", "アラーム追加", "알람 추가", "Ajouter alarme", "Alarm hinzufügen", "Añadir alarma", "Добавить будильник", "Adde horologium"}},
    {"confirm_delete", {"Delete this alarm?", "删除这个闹钟？", "刪除這個鬧鐘？", "このアラームを削除？", "이 알람을 삭제할까요?", "Supprimer cette alarme ?", "Alarm löschen?", "¿Eliminar alarma?", "Удалить будильник?", "Dele horologium?"}},
    {"delete", {"Delete", "删除", "刪除", "削除", "삭제", "Supprimer", "Löschen", "Eliminar", "Удалить", "Dele"}},
    {"cancel", {"Cancel", "取消", "取消", "キャンセル", "취소", "Annuler", "Abbrechen", "Cancelar", "Отмена", "Abroga"}},
    {"add", {"Add", "添加", "新增", "追加", "추가", "Ajouter", "Hinzufügen", "Añadir", "Добавить", "Adde"}},
    {"ok", {"OK", "确定", "確定", "OK", "확인", "OK", "OK", "OK", "OK", "Est"}},
    {"sw_start", {"START", "开始", "開始", "スタート", "시작", "DÉPART", "START", "INICIO", "СТАРТ", "INITIUM"}},
    {"sw_stop", {"STOP", "停止", "停止", "ストップ", "정지", "ARRÊT", "STOPP", "PARAR", "СТОП", "SISTE"}},
    {"sw_lap", {"LAP", "计圈", "計圈", "ラップ", "랩", "TOUR", "RUNDE", "VUELTA", "КРУГ", "CIRCULUS"}},
    {"sw_reset", {"RESET", "复位", "歸零", "リセット", "초기화", "RÉINIT.", "RESET", "REINICIO", "СБРОС", "RENOVA"}},
    {"wd_sun", {"SUN", "周日", "週日", "日", "일", "DIM", "SO", "DOM", "ВС", "SOL"}},
    {"wd_mon", {"MON", "周一", "週一", "月", "월", "LUN", "MO", "LUN", "ПН", "LUN"}},
    {"wd_tue", {"TUE", "周二", "週二", "火", "화", "MAR", "DI", "MAR", "ВТ", "MAR"}},
    {"wd_wed", {"WED", "周三", "週三", "水", "수", "MER", "MI", "MIÉ", "СР", "MER"}},
    {"wd_thu", {"THU", "周四", "週四", "木", "목", "JEU", "DO", "JUE", "ЧТ", "IOV"}},
    {"wd_fri", {"FRI", "周五", "週五", "金", "금", "VEN", "FR", "VIE", "ПТ", "VEN"}},
    {"wd_sat", {"SAT", "周六", "週六", "土", "토", "SAM", "SA", "SÁB", "СБ", "SAT"}},
    {"watchface_tips", {"Long press\nto toggle second dot", "长按切换秒点", "長按切換秒點", "長押しで秒点切替", "길게 눌러 초 표시 전환", "Appui long : point des secondes", "Lang drücken: Sekundenpunkt", "Pulsación larga: punto", "Долгое нажатие: точка", "Tene: punctum secundarum"}},
    {"next", {"Next", "下一步", "下一步", "次へ", "다음", "Suivant", "Weiter", "Siguiente", "Далее", "Porro"}},
    {"button_sfx", {"Button SFX", "按键音效", "按鍵音效", "ボタン音", "버튼 소리", "Son des touches", "Tastenton", "Sonido de botón", "Звук кнопок", "Sonus bullae"}},
    {"button_vibration", {"Button Vibration", "按键振动", "按鍵震動", "ボタン振動", "버튼 진동", "Vibration des touches", "Tastenvibration", "Vibración de botón", "Вибрация кнопок", "Vibratio bullae"}},
    {"switched", {"Switched.", "已切换", "已切換", "切り替えました", "전환됨", "Basculé.", "Gewechselt.", "Cambiado.", "Переключено.", "Mutatum."}},
